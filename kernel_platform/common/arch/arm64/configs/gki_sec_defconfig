## kernel_platform/common/arch/arm64/configs/gki_sec_defconfig
```kconfig
# Samsung defconfig for GKI build
# SEC_PRODUCT_FEATURE_KNOX_SUPPORT_NPA
CONFIG_KNOX_NCM=y

# KNOX-DDAR
CONFIG_DDAR=y

# [ SEC_SELINUX_PORTING_COMMON
CONFIG_EXT4_FS_SECURITY=y
CONFIG_AUDIT=y
CONFIG_LSM_MMAP_MIN_ADDR=4096
CONFIG_SECURITY_SELINUX=y
CONFIG_DEFAULT_SECURITY_SELINUX=y
CONFIG_NETFILTER_ADVANCED=y
CONFIG_NETFILTER_XT_TARGET_LOG=y
CONFIG_SECURITY_SELINUX_DEVELOP=y
CONFIG_AUDITSYSCALL=y
CONFIG_PROC_AVC=y
# ] SEC_SELINUX_PORTING_COMMON

# FIPS
# CONFIG_CRYPTO_SKC_FIPS is not set



# CONFIG_UH is not set




# CONFIG_RKP is not set




# CONFIG_KDP is not set




# CONFIG_FIVE is not set




# CONFIG_PROCA is not set




# CONFIG_GAF is not set




















































































# CONFIG_SECURITY_DEFEX is not set




# CONFIG_SECURITY_DEFEX_IMR is not set




CONFIG_SMB_SERVER=y




CONFIG_SMB_SERVER_CHECK_CAP_NET_ADMIN=y




CONFIG_SECURITY_DSMS=y




CONFIG_SECURITY_KUMIHO=y




CONFIG_NTFS3_FS=y












CONFIG_NTFS3_LZX_XPRESS=y












CONFIG_NLS=y












CONFIG_EROFS_FS=y












CONFIG_F2FS_FS=y












CONFIG_F2FS_FS_SECURITY=y












CONFIG_F2FS_FS_COMPRESSION=y












CONFIG_EXT4_FS_POSIX_ACL=y
```

## kernel_platform/common/arch/arm64/configs/gorhanhee_defconfig
```kconfig
# Disable Samsung anti-root protection
CONFIG_UH=n
CONFIG_RKP=n
CONFIG_KDP=n
CONFIG_SECURITY_DEFEX=n
CONFIG_PROCA=n
CONFIG_FIVE=n
```

## vendor/qcom/opensource/display-drivers/sec_display_defconfig
```kconfig
CONFIG_SECDP=y # nocheck: It is intended for displayport, ignore it.
CONFIG_SECDP_LOGGER=y # nocheck: It is intended for displayport, ignore it.
CONFIG_SECDP_BIGDATA=y # nocheck: It is intended for displayport, ignore it.
CONFIG_SECDP_SWITCH=y # nocheck: It is intended for displayport, ignore it.
CONFIG_SECDP_DBG=y # nocheck: It is intended for displayport, ignore it.
CONFIG_SECDP_FACTORY_DPSWITCH_TEST=y # nocheck: It is intended for displayport, ignore it.

CONFIG_PANEL_PA2_S6E3HAF_AMB666FM03_VHM_WQHD=y
CONFIG_PANEL_PA2_S6E3HAF_AMB666FM03_WQHD=y
CONFIG_PANEL_PA2_S6E3HAF_AMB666FM01_WQHD=y
CONFIG_DISPLAY_SAMSUNG=y
CONFIG_LCD_CLASS_DEVICE=y
```
